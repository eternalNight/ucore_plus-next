## ucore/src/kern-ucore/trace/Kconfig
```kconfig
menu Tracing

config TRACE
    bool "enable tracing"
    default y

if TRACE

config FTRACE
    bool "ftrace"
    default y
    help
        Similar to https://www.kernel.org/doc/Documentation/trace/ftrace.txt
        and https://www.kernel.org/doc/Documentation/trace/ftrace-design.txt.

endif

endmenu


 
```
